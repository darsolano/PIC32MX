_VPATH	+=:$(ROOT)/dma/source

PROCOBJ	+= dma_chn_abort_txfer_lib.o
PROCOBJ	+= dma_chn_clr_ev_enable_flags_lib.o
PROCOBJ	+= dma_chn_set_ev_enable_flags_lib.o
PROCOBJ	+= dma_chn_clr_ev_flags_lib.o
PROCOBJ	+= dma_chn_set_ev_flags_lib.o
PROCOBJ	+= dma_chn_open_lib.o
PROCOBJ	+= dma_chn_configure_lib.o
PROCOBJ	+= dma_chn_disable_lib.o
PROCOBJ	+= dma_chn_enable_lib.o
PROCOBJ	+= dma_chn_get_cell_pnt_lib.o
PROCOBJ	+= dma_chn_get_control_flags_lib.o
PROCOBJ	+= dma_chn_get_dst_pnt_lib.o
PROCOBJ	+= dma_chn_get_ev_detect_lib.o
PROCOBJ	+= dma_chn_get_ev_enable_flags_lib.o
PROCOBJ	+= dma_chn_get_event_control_lib.o
PROCOBJ	+= dma_chn_get_ev_flags_lib.o
PROCOBJ	+= dma_chn_get_match_pattern_lib.o
PROCOBJ	+= dma_chn_get_src_pnt_lib.o
PROCOBJ	+= dma_chn_get_txfer_lib.o
PROCOBJ	+= dma_chn_memcpy_lib.o
PROCOBJ	+= dma_chn_mem_crc_lib.o
PROCOBJ	+= dma_chn_mem_checksum_lib.o
PROCOBJ	+= dma_chn_set_control_flags_lib.o
PROCOBJ	+= dma_chn_clr_control_flags_lib.o
PROCOBJ	+= dma_chn_write_control_flags_lib.o
PROCOBJ	+= dma_chn_set_event_control_flags_lib.o
PROCOBJ	+= dma_chn_clr_event_control_flags_lib.o
PROCOBJ	+= dma_chn_write_event_control_flags_lib.o
PROCOBJ	+= dma_chn_set_match_pattern_lib.o
PROCOBJ	+= dma_chn_set_txfer_lib.o
PROCOBJ	+= dma_chn_start_txfer_lib.o
PROCOBJ	+= dma_chn_strcpy_lib.o
PROCOBJ	+= dma_chn_strncpy_lib.o
PROCOBJ	+= dma_chn_write_ev_enable_flags_lib.o
PROCOBJ	+= dma_chn_write_ev_flags_lib.o
PROCOBJ	+= dma_crc_attach_channel_lib.o
PROCOBJ	+= dma_sfm_attach_channel_lib.o
PROCOBJ	+= dma_crc_result_lib.o
PROCOBJ	+= dma_get_status_lib.o
PROCOBJ	+= dma_reg_map_tbl_lib.o
PROCOBJ	+= dma_chn_force_txfer_lib.o
PROCOBJ	+= dma_chn_set_src_add_lib.o
PROCOBJ	+= dma_chn_set_dst_add_lib.o
PROCOBJ	+= dma_chn_get_control_lib.o

